#include "roBa.dtsi"
#include <dt-bindings/input/input-event-codes.h> 

&kscan0 {
        col-gpios
            = <&xiao_d 10 GPIO_ACTIVE_HIGH>
            , <&xiao_d 9 GPIO_ACTIVE_HIGH> 
            , <&xiao_d 8 GPIO_ACTIVE_HIGH> 
            , <&xiao_d 7 GPIO_ACTIVE_HIGH> 
            , <&gpio0 10 GPIO_ACTIVE_HIGH>
            , <&gpio0 9 GPIO_ACTIVE_HIGH>
            ;
};

&left_encoder {
    status = "okay";
};

 / {                      /* ルートノード（& ではなく / ）*/
    scroll_ultrafine: scroll_ultrafine {
        compatible = "zmk,input-processor-scaler";
        status = "disabled";         /* ← 実際には使わない */
        #input-processor-cells = <2>;
        type  = <INPUT_EV_REL>;
        codes = <INPUT_REL_WHEEL INPUT_REL_HWHEEL>;
        /* multiplier / divisor / track-remainders はそのままでも可 */
        multiplier = <1>;
        divisor    = <8>;
        track-remainders;
    };
};